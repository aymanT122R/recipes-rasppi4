## conf/layer.conf
```bitbake
# We have a conf and classes directory, add to BBPATH
BBPATH .= ":${LAYERDIR}"

# We have recipes-* directories, add to BBFILES
BBFILES += "${LAYERDIR}/recipes-*/*/*.bb \
            ${LAYERDIR}/recipes-*/*/*.bbappend"

BBFILE_COLLECTIONS += "meta-raspberrypi4"
BBFILE_PATTERN_meta-raspberrypi4 = "^${LAYERDIR}/"
BBFILE_PRIORITY_meta-raspberrypi4 = "6"

LAYERDEPENDS_meta-raspberrypi4 = "core"
LAYERSERIES_COMPAT_meta-raspberrypi4 = "scarthgap"
```
